## Documentation/devicetree/bindings/gpio/gpio-axxia-sspcs.txt
```
* Axxia SSP GPIO chip-select driver

The Axxia device has a ARM PL022 Prime Cell SSP controller with an extension of
five chip select signals that may be controlled by software. This driver
exports them as GPIOs.

Required properties:

  * compatible: should be "lsi,ssp-gpio"
  * reg: base address for the controller.
  * gpio-controller: mark the device as gpio controller
  * #gpio-cells: should be 1 and this field specifies the chip select number

Example:
-------

	spics: sspgpio@2010088030 {
		compatible = "lsi,ssp-gpio";
		#gpio-cells = <1>;
		reg = <0x20 0x10088000 0x00 0x1000>;
		gpio-controller;
	};

	spi0: ssp@2010088000 {
		compatible = "arm,pl022", "arm,primecell";
		#address-cells = <1>;
		#size-cells = <0>;
		reg = <0x20 0x10088000 0x00 0x1000>;
		num-cs = <5>;
		cs-gpios = <&spics 0>,
			   <&spics 1>,
			   <&spics 2>,
			   <&spics 3>,
			   <&spics 4>;
		...
      };
```

## Documentation/devicetree/bindings/interrupt-controller/lsi,axxia-gic.txt
```
* Axxia Interrupt Controller

Based on the binding for ARM GIC with virtualization extensions (VGIC), see:

	Documentation/devicetree/bindings/arm/gic.txt

with a few differences to the required properties:

- compatible : should be "lsi,axxia-gic"

- reg :  should contain two additional cells: The 5th and 6th cell should hold
  the physical address to the IPI mask and the IPI send registers respectively.

Example:

	gic: interrupt-controller@2001001000 {
		compatible = "lsi,axxia-gic", "arm,cortex-a15-gic";
		#interrupt-cells = <3>;
		#address-cells = <0>;
		interrupt-controller;
		reg = <0x20 0x01001000 0 0x1000>,  /* gic dist base */
		      <0x20 0x01002000 0 0x1000>,  /* gic cpu base */
		      <0x20 0x01004000 0 0x2000>,  /* vgic control */
		      <0x20 0x01006000 0 0x2000>,  /* vgic cpu base */
		      <0x20 0x10030000 0 0x1000>,  /* axm IPI mask reg base */
		      <0x20 0x10040000 0 0x20000>; /* axm IPI send reg base */
		interrupts = <1 9 0xf04>;
	};
```

## Documentation/devicetree/bindings/pci/lsi,axxia-pcie.txt
```
* LSI Axxia PCIe controller

Required properties:

- compatible: should contain "lsi,axxia-pcie"
- reg: base addresses and lengths of the pcie controller registers
	and the register window to access configuration space.
- interrupts: first entry for legacy interrupt and the optional following
	entries for MSI lines.
- #address-cells: set to <3>
- #size-cells: set to <2>
- device_type: set to "pci"
- ranges: ranges for the outbound PCI memory region on the form:
	<3-cell PCI addr> <2-cell CPU addr> <2-cell size>
- dma-ranges: ranges for the inbound memory window on the form:
	<3-cell PCI addr> <2-cell CPU addr> <2-cell size>
- #interrupt-cells: set to <1>

Example:
	pcie0: pciex@3000000000 {
		compatible = "lsi,axxia-pcie";
		device_type = "pci";
		#interrupt-cells = <1>;
		#address-cells = <3>;
		#size-cells = <2>;
		reg = <0x30 0x38000000 0x0 0x01000000>,
		      <0x20 0x20120000 0x0 0x00008000>;
		/* Outbound ranges */
		ranges = <0x03000000 0x00000000 0x80000000
			  0x30 0x00000000
			  0x00 0x20000000>;
		/* Inbound ranges */
		/* < <3-cell PCI addr> <2-cell CPU addr> <2-cell size> > */
		dma-ranges = <0x03000000 0x00000000 0x00000000
			      0x00 0x00000000
			      0x00 0x40000000>;
		interrupts = <0 68 4>;
	};
```

## Documentation/devicetree/bindings/usb/ehci-axxia.txt
```
Axxia USB EHCI controller

Required properties:

- compatible: should be "lsi,axxia-ehci" or "lsi,acp-usb" (legacy)
- reg: should contain one register range i.e. start and length
- interrupts: definition of the interrupt line

Optional properties:

- dma-coherent: Present if dma operations are coherent

Example for AXM5516:

usb@2010140000 {
	compatible = "lsi,axxia-ehci";
	reg = <0x20 0x10140000 0 0x1000>;
	interrupts = <GIC_SPI 55 IRQ_TYPE_LEVEL_HIGH>;
	dma-coherent;
};
```

## drivers/net/ethernet/lsi/Kconfig
```kconfig
config NET_VENDOR_LSI
	bool "LSI AXM55xx Ethernet support"
	select MII
	select PHYLIB
	default y if ARCH_AXXIA
        ---help---
	  If you have a network interface driver for LSI AXXIA series, say Y

	  Note that the answer to this question doesn't directly affect the
	  kernel: saying N will just cause the configurator to skip all
	  the questions about LSI devices. If you say Y, you will be
	  asked for your specific card in the following questions.

if NET_VENDOR_LSI

config NET_LSI_MDIO
        bool "LSI AXM55xx MDIO bus driver"
        default y
        ---help---
          The MDIO controller in AXM55xx devices.

          If your board uses an external PHY connected to FEMAC, say Y.

config NET_LSI_FEMAC
        tristate "LSI FEMAC Ethernet controller"
        select LSI_MDIO
        default y
        ---help---
          Say Y here if you want to use the built-in 10/100 Fast ethernet
          controller (FEMAC) on the AXM55xx devices.

endif # NET_VENDOR_LSI
```
